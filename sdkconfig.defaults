## sdkconfig.defaults
```kconfig
# sdkconfig.defaults — Drone ESP32-S3 N16R8
# Fonte canonica: CLAUDE.md §2

# ----- PSRAM Octal (CRITICO p/ N16R8) -----
CONFIG_ESPTOOLPY_FLASHSIZE="16MB"
CONFIG_SPIRAM=y
CONFIG_SPIRAM_MODE_OCT=y
CONFIG_SPIRAM_SPEED_80M=y
CONFIG_SPIRAM_USE_MALLOC=y
CONFIG_SPIRAM_TRY_ALLOCATE_WIFI_LWIP=y

# ----- FreeRTOS SMP (Core 0 = network, Core 1 = flight) -----
CONFIG_FREERTOS_UNICORE=n
CONFIG_FREERTOS_HZ=1000

# ----- Watchdogs -----
CONFIG_ESP_TASK_WDT=y
CONFIG_ESP_TASK_WDT_TIMEOUT_S=5
CONFIG_ESP_INT_WDT=y
CONFIG_ESP_INT_WDT_TIMEOUT_MS=300

# ----- Brownout (CLAUDE.md §6.1) -----
CONFIG_ESP_BROWNOUT_DET=y
CONFIG_ESP_BROWNOUT_DET_LVL_SEL_7=y

# ----- Camera OV2640 -----
CONFIG_OV2640_SUPPORT=y
CONFIG_CAMERA_TASK_STACK_SIZE=4096

# ----- Wi-Fi co-existencia c/ camera -----
CONFIG_ESP_WIFI_STATIC_RX_BUFFER_NUM=16
CONFIG_ESP_WIFI_DYNAMIC_RX_BUFFER_NUM=32

# ----- Coredump -----
CONFIG_ESP_COREDUMP_ENABLE_TO_FLASH=y
CONFIG_ESP_COREDUMP_DATA_FORMAT_ELF=y
CONFIG_ESP_COREDUMP_CHECKSUM_CRC32=y

# ----- Toolchain -----
CONFIG_COMPILER_CXX_EXCEPTIONS=n
CONFIG_COMPILER_CXX_RTTI=n
CONFIG_COMPILER_OPTIMIZATION_PERF=y
CONFIG_COMPILER_WARN_WRITE_STRINGS=y
```

## sdkconfig.defaults.esp32s3
```kconfig
# Overrides especificos do target esp32s3
# Aplicado sobre sdkconfig.defaults quando IDF_TARGET=esp32s3

CONFIG_IDF_TARGET="esp32s3"

# CPU @ 240 MHz
CONFIG_ESP_DEFAULT_CPU_FREQ_MHZ_240=y
CONFIG_ESP_DEFAULT_CPU_FREQ_MHZ=240

# Caches — perfil de performance
CONFIG_ESP32S3_INSTRUCTION_CACHE_32KB=y
CONFIG_ESP32S3_INSTRUCTION_CACHE_8WAYS=y
CONFIG_ESP32S3_DATA_CACHE_64KB=y
CONFIG_ESP32S3_DATA_CACHE_LINE_64B=y
```
